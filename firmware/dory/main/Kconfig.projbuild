## firmware/dory/main/Kconfig.projbuild
```kconfig
menu "Dory"

config DORY_DEBUG_SERIAL
    bool "Enable serial debug commands"
    default n
    help
        Enables the serial command task for manually testing board functions.

config DORY_WIRELESS
    bool "Enable wireless ESPNOW commands"
    default y
    help
        Enables using ESPNOW to communicate and send commands

endmenu
```

## firmware/main/Kconfig.projbuild
```kconfig
menu "Dory"

config DORY_DEBUG_SERIAL
    bool "Enable serial debug commands"
    default n
    help
        Enables the serial command task for manually testing board functions.

config DORY_WIRELESS
    bool "Enable wireless ESPNOW commands"
    default y
    help
        Enables using ESPNOW to communicate and send commands

config DORY_ESPNOW_BASE_MAC
    string "Base station MAC address"
    depends on DORY_WIRELESS
    default "00:00:00:00:00:00"
    help
        MAC address of the base station allowed to send ESP-NOW packets.
        Use aa:bb:cc:dd:ee:ff format.

endmenu
```
